## meta-iid/conf/distro/iid.conf
```bitbake
require conf/distro/poky.conf
require include/iid.inc

DISTRO = "iid"
DISTRO_FEATURES_append = " systemd"

PACKAGE_CLASSES = "package_ipk"

VIRTUAL-RUNTIME_dev_manager = "udev"
VIRTUAL-RUNTIME_init_manager = "systemd"
VIRTUAL-RUNTIME_initscripts = ""

DISTRO_FEATURES_BACKFILL_CONSIDERED = "sysvinit"
```

## meta-iid/conf/distro/include/iid.inc
```bitbake
SANITY_TESTED_DISTROS = " \
            Debian-7.6 \n \
            "

DISTRO_VERSION = "0.1"
DISTRO_CODENAME = "coriander"
DISTRO_NAME = "Intel IoT Reference Distro"
MAINTAINER = "someone@intel.com"

TARGET_VENDOR = "-iid"
SDK_VENDOR = "-iid"
```
